// SPDX-License-Identifier: GPL-2.0+ OR MIT
/* Qualification DT: SMC only; use before the cpufreq trial. */
#include "t8140-j700.dts"

/* SRAM geometry follows the live iop-smc-nub region-base/region-size. */
&smc_mbox {
	status = "okay";
};

&smc {
	status = "okay";
};
